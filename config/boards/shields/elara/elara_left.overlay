/*
 * Copyright (c) 2020 ZMK Contributors
 *
 * SPDX-License-Identifier: MIT
 */

#include "elara.dtsi"

&kscan0 {
	col-gpios
		= <&gpio1 12 (GPIO_ACTIVE_HIGH | GPIO_PULL_DOWN)>
		, <&gpio1 14 (GPIO_ACTIVE_HIGH | GPIO_PULL_DOWN)>
		, <&gpio1 10 (GPIO_ACTIVE_HIGH | GPIO_PULL_DOWN)>
		, <&gpio0 02 (GPIO_ACTIVE_HIGH | GPIO_PULL_DOWN)>
		;
	row-gpios
		= <&gpio0 29 GPIO_ACTIVE_HIGH>
		, <&gpio0 03 GPIO_ACTIVE_HIGH>
		, <&gpio0 28 GPIO_ACTIVE_HIGH>
		;
};

nice_view_spi: &spi1 {
    pinctrl-0 = <&spi1_default>;
    pinctrl-1 = <&spi1_sleep>;
    pinctrl-names = "default", "sleep";
    cs-gpios = <&gpio0 06 GPIO_ACTIVE_HIGH>;
};