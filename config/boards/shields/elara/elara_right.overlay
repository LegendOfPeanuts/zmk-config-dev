/*
 * Copyright (c) 2020 ZMK Contributors
 *
 * SPDX-License-Identifier: MIT
 */
 
#include "elara.dtsi"

&default_transform {
	col-offset = <3>;
};


&kscan0 {
	col-gpios
		= <&gpio1 12 (GPIO_ACTIVE_HIGH | GPIO_PULL_DOWN)>
		, <&gpio1 14 (GPIO_ACTIVE_HIGH | GPIO_PULL_DOWN)>
		, <&gpio1 10 (GPIO_ACTIVE_HIGH | GPIO_PULL_DOWN)>
		, <&gpio0 02 (GPIO_ACTIVE_HIGH | GPIO_PULL_DOWN)>
		;
	row-gpios
		= <&gpio0 29 GPIO_ACTIVE_HIGH>
		, <&gpio0 03 GPIO_ACTIVE_HIGH>
		, <&gpio0 28 GPIO_ACTIVE_HIGH>
		;
};

&right_encoder {
    status = "okay";
};