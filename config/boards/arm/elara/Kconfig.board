## config/boards/arm/elara/Kconfig.defconfig
```kconfig
if BOARD_ELARA 

config ZMK_KEYBOARD_NAME
	default "Elara"

if USB

config USB_NRFX
	default y

config USB_DEVICE_STACK
	default y

endif # USB

config BT_CTLR
	default BT

config ZMK_BLE
	default y

config I2C
	default y

config MAX17048 
	default y

endif # BOARD_ELARA
```

## config/boards/shields/elara/Kconfig.defconfig
```kconfig
if SHIELD_ELARA_RIGHT

config ZMK_KEYBOARD_NAME
	default "Elara"

config ZMK_SPLIT_BLE_ROLE_CENTRAL
	default y

config ZMK_USB
	default y

endif

if SHIELD_ELARA_LEFT || SHIELD_ELARA_RIGHT

config ZMK_SPLIT
	default y
	
endif
```

## config/boards/shields/elara/Kconfig.shield
```kconfig
config SHIELD_ELARA_LEFT
	def_bool $(shields_list_contains,elara_left)

config SHIELD_ELARA_RIGHT
	def_bool $(shields_list_contains,elara_right)
```

## config/west.yml
```yaml
manifest:
  remotes:
    - name: zmkfirmware
      url-base: https://github.com/petejohanson
    - name: inorichi
      url-base: https://github.com/inorichi
  projects:
    - name: zmk
      remote: zmkfirmware
      revision: 0e2f94b73bc18e3be7d913d2a233ae6330b40624
      import: app/west.yml
    - name: zmk-pmw3610-driver
      remote: inorichi
      revision: main
  self:
    path: configds
```
